## components/ramses-led/Kconfig.projbuild
```kconfig
menu "LED Configuration"

	config GPIO_RX_LED
		int "RX LED GPIO"
		default 20
        help
        	GPIOx for RX LED

	config GPIO_TX_LED
		int "TX LED GPIO"
		default 21
        help
        	GPIOx for TX LED
  		
endmenu
```
